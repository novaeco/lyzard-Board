## sdkconfig.defaults
```kconfig
# Recommended default configuration for Lyzard Board
CONFIG_IDF_TARGET="esp32s3"

# LVGL basics
CONFIG_LV_COLOR_DEPTH_16=y
CONFIG_LV_COLOR_DEPTH=16
CONFIG_LV_MEM_SIZE_KILOBYTES=64
CONFIG_LV_USE_THEME_DEFAULT=y
CONFIG_LV_THEME_DEFAULT_GROW=y
CONFIG_LV_THEME_DEFAULT_TRANSITION_TIME=80
```
